## sirene-validator/components/board_config/Kconfig
```kconfig
menu "Sirene board config"

choice SIRENE_BOARD_PROFILE
    prompt "GPIO profile (hardware da placa)"
    default SIRENE_BOARD_DIPONTO
    help
        Diponto producao: rele GPIO4, botao GPIO5, PZEM 27/26.
        Legacy devkit (v1.1.4): rele GPIO26, botao GPIO0, PZEM 17/16 —
        use se o OLED integrado parou apos atualizar (SDA livre no GPIO4).

config SIRENE_BOARD_DIPONTO
    bool "Diponto producao (rele 4, botao 5)"

config SIRENE_BOARD_LEGACY_DEVKIT
    bool "Legacy devkit v1.1.4 (rele 26, botao 0)"

endchoice

config SIRENE_MQTT_DEFAULT_USER
    string "MQTT default username (factory NVS)"
    default "devices"
    help
        Written to NVS on first provisioning when mqtt_cfg is empty.
        Override via menuconfig or sdkconfig.defaults.local (not committed).

config SIRENE_MQTT_DEFAULT_PASSWORD
    string "MQTT default password (factory NVS)"
    default ""
    help
        Required for production builds. Set in sdkconfig.defaults.local
        or idf.py menuconfig. Never commit real passwords to Git.

config SIRENE_WIFI_AP_PASSWORD
    string "Wi-Fi AP password (provisioning)"
    default "diponto2026"
    help
        Empty = derive from device MAC (sv + 6 hex). Non-empty = fixed AP password.

config SIRENE_MQTT_LAN_INSECURE_TLS
    bool "Allow insecure TLS for private-LAN MQTT brokers"
    default y
    help
        Self-signed certificates on LAN brokers skip server verification
        only when the broker host is RFC1918. Cloud brokers always use CA bundle.

endmenu
```

## sirene-validator/components/line_actuator/Kconfig
```kconfig
menu "Line actuator"

config LINE_ACTUATOR_ENABLE
    bool "Enable line actuator (reject/approve GPIO)"
    default y
    help
        GPIO outputs for physical sorting (reject conveyor relay, optional approve stack light).
        Verdict and GPIO fire before MQTT publish (edge-first).

config LINE_ACTUATOR_REJECT_GPIO
    int "Reject GPIO number (-1 = disabled)"
    range -1 39
    default -1
    depends on LINE_ACTUATOR_ENABLE
    help
        Optional pulse on REPROVADO for conveyor/solenoid sorting. -1 = disabled (bench: button + relay only).
        Relay load sirene remains on GPIO_RELAY.

config LINE_ACTUATOR_APPROVE_GPIO
    int "Approve GPIO number (-1 = disabled)"
    range -1 39
    default -1
    depends on LINE_ACTUATOR_ENABLE
    help
        Optional pulse on APROVADO (stack light). -1 = LED only.

config LINE_ACTUATOR_ACTIVE_HIGH
    bool "Actuator outputs active high"
    default y
    depends on LINE_ACTUATOR_ENABLE

config LINE_ACTUATOR_REJECT_PULSE_MS
    int "Reject pulse duration (ms)"
    range 50 2000
    default 300
    depends on LINE_ACTUATOR_ENABLE

config LINE_ACTUATOR_APPROVE_PULSE_MS
    int "Approve pulse duration (ms)"
    range 50 2000
    default 200
    depends on LINE_ACTUATOR_ENABLE

config LINE_ACTUATOR_PUBLISH_TELEMETRY
    bool "Publish tipo:atuador telemetry on pulse"
    default y
    depends on LINE_ACTUATOR_ENABLE

endmenu
```

## sirene-validator/components/oled_display/Kconfig
```kconfig
menu "Sirene OLED display"

config SIRENE_OLED_ENABLE
    bool "Enable SSD1306 OLED status display (I2C)"
    default y
    help
        Mostra estado FSM, OP e ultimo teste no display 128x64.
        Desative se a placa nao tiver OLED.

config SIRENE_OLED_I2C_ADDR
    hex "SSD1306 I2C address"
    default 0x3C
    depends on SIRENE_OLED_ENABLE

config SIRENE_OLED_SDA_GPIO
    int "OLED I2C SDA GPIO"
    range 0 39
    default 21 if SIRENE_BOARD_DIPONTO
    default 4 if SIRENE_BOARD_LEGACY_DEVKIT
    depends on SIRENE_OLED_ENABLE

config SIRENE_OLED_SCL_GPIO
    int "OLED I2C SCL GPIO"
    range 0 39
    default 22 if SIRENE_BOARD_DIPONTO
    default 15 if SIRENE_BOARD_LEGACY_DEVKIT
    depends on SIRENE_OLED_ENABLE

endmenu
```

## sirene-validator/components/ota_update/Kconfig
```kconfig
menu "OTA update"

config OTA_ERASE_NVS_ON_BOOT
    bool "Erase NVS + storage on first boot after OTA"
    default n
    help
        When enabled, the first boot after a successful OTA (image
        pending verify) erases the nvs and storage partitions before
        connecting. The device then enters Wi-Fi provisioning (AP
        SireneValidator). Disable for normal production OTA updates.

config SIRENE_OTA_REQUIRE_HTTPS
    bool "Require HTTPS URLs for OTA_UPDATE command"
    default y
    help
        When enabled, rejects http:// OTA URLs except on private LAN
        (192.168/10/172.16) and *.local hosts. Public http:// is blocked;
        https:// on LAN is always allowed.

endmenu
```

## sirene-validator/components/pzem/Kconfig
```kconfig
menu "PZEM"

config DEV_MOCK_PZEM
    bool "Use mock PZEM readings (development only)"
    default n
    help
        When enabled, pzem_measure_cycle generates synthetic power samples
        instead of reading the PZEM-004T over UART. Use only on development
        benches without the sensor wired. Never enable in production firmware.

config PZEM_FAST_READ
    bool "Fast PZEM read (fewer UART retries per sample)"
    default y
    help
        Reduces Modbus retries during measure_cycle for higher throughput.
        Disable if UART is noisy on long cable runs.

config PZEM_WORKER_CORE
    int "CPU core for PZEM worker task (test/calibration)"
    range 0 1
    default 0
    help
        Pin test/calibration worker to Core 0 (critical path). Wi-Fi/MQTT use Core 1.

endmenu
```
